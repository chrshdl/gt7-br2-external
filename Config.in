## Config.in
```kconfig
menu "GT7 external options"
    source "$BR2_EXTERNAL_GT7_SIMDASH_PATH/package/gt7-simdash/Config.in"
endmenu
```

## package/gt7-simdash/Config.in
```kconfig
config BR2_PACKAGE_GT7_SIMDASH
    bool "gt7-simdash"
    help
      Python HMI for GT7 on Raspberry Pi.
```
